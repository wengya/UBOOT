## board/freescale/mx6ull_100ask_evk/Kconfig
```kconfig
if TARGET_MX6ULL_100ASK_EVK || TARGET_MX6ULL_9X9_EVK

config SYS_BOARD
	default "mx6ull_100ask_evk"

config SYS_VENDOR
	default "freescale"

config SYS_CONFIG_NAME
	default "mx6ull_100ask_evk"

endif
```
